## Documentation/devicetree/bindings/input/gpio-keys-polled.txt
```
Device-Tree bindings for input/gpio_keys_polled.c keyboard driver

Required properties:
	- compatible = "gpio-keys-polled";
	- poll-interval: Poll interval time in milliseconds

Optional properties:
	- autorepeat: Boolean, Enable auto repeat feature of Linux input
	  subsystem.

Each button (key) is represented as a sub-node of "gpio-keys-polled":
Subnode properties:

	- gpios: OF device-tree gpio specification.
	- label: Descriptive name of the key.
	- linux,code: Key / Axis code to emit.

Optional subnode-properties:
	- linux,input-type: Specify event type this button/key generates.
	  If not specified defaults to <1> == EV_KEY.
	- linux,input-value: If linux,input-type is EV_ABS or EV_REL then this
	  value is send for events this button generates when pressed.
	  EV_ABS axis will generate an event with a value of 0 when all
	  buttons with linux,input-type == EV_ABS and linux,code == axis
	  are released.
	- debounce-interval: Debouncing interval time in milliseconds.
	  If not specified defaults to 5.
	- gpio-key,wakeup: Boolean, button can wake-up the system.

Example nodes:

	gpio_keys_polled {
			compatible = "gpio-keys-polled";
			#address-cells = <1>;
			#size-cells = <0>;
			poll-interval = <100>;
			autorepeat;
			button@21 {
				label = "GPIO Key UP";
				linux,code = <103>;
				gpios = <&gpio1 0 1>;
			};
			...
```

## Documentation/devicetree/bindings/net/rfkill-gpio.txt
```
Linux rfkill-gpio Bindings
--------------------------

This binding provides support the rfkill via an gpio interface.

Note: Only one of the gpios definitions is required. If both are set, both
will be toggled uppon rfkill invocation.

Required properties:
- compatible		Should be one of:
				"linux,rfkill-gpio"
- type			Shall be one of:
				"wlan"
				"bluetooth"
				"ultrawideband"
				"wimax"
				"wwan"
				"gps"
				"fm"
				"nfc"
			If left undefined, the 'RFKILL_TYPE_ALL' type
			shall be used.

- shutdown-gpios	Which GPIO to use for shutdown
or
- reset-gpios		Which GPIO to use for reset

Example:
       phy0-kill {
               compatible = "linux,rfkill-gpio";
               type = "wlan";
               shutdown-gpios = <&pio 2 17 GPIO_ACTIVE_HIGH>;
       };
```

## drivers/gpu/drm/bridge/sn65dsi84/Kconfig
```kconfig
config DRM_TI_SN65DSI84
	tristate "sn65dsi84 bridge"
	depends on OF
	select DRM_KMS_HELPER
	select REGMAP_I2C
	help
	  Support for the TI SN65DSI84 LVDS Bridge.

config DRM_SNDEBUG
	bool "Debug for SN65dsi84"
	default n
	depends on DRM_TI_SN65DSI84
	help
		debug with sysfs 
		
config DRM_PRNDEBUG
	bool "Printk debug for SN65DSI84"
	default n
	depends on DRM_SNDEBUG
	help
		debug with printk 		
```

## drivers/net/wireless/realtek/rtl8822ce/Kconfig
```kconfig
config RTL8822CE
	tristate "Realtek 8822C PCIE WiFi"
	depends on PCI
	depends on WLAN && CFG80211
	select WIRELESS_EXT
	select WEXT_PRIV
	---help---
	  Help message of RTL8822CE
```
