/*
 * Copyright 2017-2021 congatec GbmH
 *
 * This program is free software; you can redistribute it and/or
 * modify it under the terms of the GNU General Public License
 * as published by the Free Software Foundation; either version 2
 * of the License, or (at your option) any later version.
 *
 * This program is distributed in the hope that it will be useful,
 * but WITHOUT ANY WARRANTY; without even the implied warranty of
 * MERCHANTABILITY or FITNESS FOR A PARTICULAR PURPOSE.  See the
 * GNU General Public License for more details.
 */

#include "../freescale/fsl-imx8dxp.dtsi"
#include "imx8x-cgtsx8x.dtsi"

/ {
	model = "conga SMX8-X aka SX8X";
	compatible = "fsl,imx8qxp-mek", "fsl,imx8dxp", "fsl,imx8qxp";
};
