/dts-v1/;

#include "imx8mm-cgtsx8m-lvds.dtsi"

/ {
        lvdspanel {

                panel-timing {
			clock-frequency = <83465487>;
			hactive = <1280>;
			vactive = <800>;
			hsync-len = <136>;
			hfront-porch = <64>;
			hback-porch = <200>;
			vsync-len = <3>;
			vfront-porch = <1>;
			vback-porch = <24>;
                };
        };
};
