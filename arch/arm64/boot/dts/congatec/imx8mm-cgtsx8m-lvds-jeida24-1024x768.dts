// SPDX-License-Identifier: (GPL-2.0+ OR MIT)
/*
 * Copyright (C) 2025 congatec GmbH
 * Author: Lukas Posadka <lukas.posadka@congatec.com>
 */

/dts-v1/;

#include "imx8mm-cgtsx8m-lvds.dtsi"

/ {
	panel-lvds {
		width-mm = <249>;
		height-mm = <188>;

		data-mapping = "jeida-24";

		panel-timing {
			clock-frequency = <65002600>;
			hactive = <1024>;
			vactive = <768>;
			hsync-len = <136>;
			hfront-porch = <24>;
			hback-porch = <160>;
			vsync-len = <6>;
			vfront-porch = <3>;
			vback-porch = <29>;
		};
	};
};

