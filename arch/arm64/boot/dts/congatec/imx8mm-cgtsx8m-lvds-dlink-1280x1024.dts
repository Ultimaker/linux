// SPDX-License-Identifier: (GPL-2.0+ OR MIT)
/*
 * Copyright (C) 2025 congatec GmbH
 * Author: Lukas Posadka <lukas.posadka@congatec.com>
 */

/dts-v1/;

#include "imx8mm-cgtsx8m-lvds-dlink.dtsi"

/ {
	panel-lvds {
		width-mm = <346>;
		height-mm = <274>;

		data-mapping = "vesa-24";

		panel-timing {
			clock-frequency = <110011001>;
			hactive = <1280>;
			vactive = <1024>;
			hsync-len = <184>;
			hfront-porch = <48>;
			hback-porch = <200>;
			vsync-len = <3>;
			vfront-porch = <1>;
			vback-porch = <26>;
		};
	};
};

