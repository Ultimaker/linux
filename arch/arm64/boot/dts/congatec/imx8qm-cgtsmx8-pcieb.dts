/*
 * Copyright 2017-2018 NXP
 * Copyright 2021 congatec GmbH
 *
 * This program is free software; you can redistribute it and/or
 * modify it under the terms of the GNU General Public License
 * as published by the Free Software Foundation; either version 2
 * of the License, or (at your option) any later version.
 *
 * This program is distributed in the hope that it will be useful,
 * but WITHOUT ANY WARRANTY; without even the implied warranty of
 * MERCHANTABILITY or FITNESS FOR A PARTICULAR PURPOSE.  See the
 * GNU General Public License for more details.
 */

/*
 * SATA disabled, in order to use pcieb
 */

/dts-v1/;

#include "imx8qm-cgtsmx8.dts"

&pcieb {
	status = "okay";
};

&sata {
	status = "disabled";
};
